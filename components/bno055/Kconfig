## components/bno055/Kconfig
```kconfig
menu "BNO055"

    # Sensor fusion mode
    choice BNO055_OPMODE
        prompt "Operation mode"
        default BNO055_OPMODE_IMUPLUS

        config BNO055_OPMODE_IMUPLUS
            bool "IMUPLUS (accel + gyro)"

        config BNO055_OPMODE_NDOF
            bool "NDOF (accel + gyro + mag)"

    endchoice

    # I2C buses
    config BNO055_I2C0_SDA
        int "I2C0 SDA GPIO"
        default 21

    config BNO055_I2C0_SCL
        int "I2C0 SCL GPIO"
        default 22

    config BNO055_I2C1_SDA
        int "I2C1 SDA GPIO"
        default 25

    config BNO055_I2C1_SCL
        int "I2C1 SCL GPIO"
        default 26

    # BNO055 addresses
    config BNO055_ADDR1
        hex "IMU address with ADR low"
        default 0x28

    config BNO055_ADDR2
        hex "IMU address with ADR high"
        default 0x29

endmenu
```

## main/Kconfig
```kconfig
menu "esp32_imu_arm board"

    # Pressure sensors
    # A0 = GPIO36 = CH0, A1 = GPIO39 = CH3, A2 = GPIO34 = CH6, A3 = GPIO35 = CH7
    config BOARD_PRESSURE_CH0
        int "Pressure sensor 0 ADC1 channel"
        range 0 7
        default 0

    config BOARD_PRESSURE_CH1
        int "Pressure sensor 1 ADC1 channel"
        range 0 7
        default 3

    config BOARD_PRESSURE_CH2
        int "Pressure sensor 2 ADC1 channel"
        range 0 7
        default 6

    config BOARD_PRESSURE_CH3
        int "Pressure sensor 3 ADC1 channel"
        range 0 7
        default 7

    # I2C buses
    config BNO055_I2C0_SDA
        int "I2C0 SDA GPIO"
        default 21

    config BNO055_I2C0_SCL
        int "I2C0 SCL GPIO"
        default 22

    config BNO055_I2C1_SDA
        int "I2C1 SDA GPIO"
        default 25

    config BNO055_I2C1_SCL
        int "I2C1 SCL GPIO"
        default 26

    # BNO055 addresses
    config BNO055_ADDR1
        hex "IMU address with ADR low"
        default 0x28

    config BNO055_ADDR2
        hex "IMU address with ADR high"
        default 0x29
endmenu
```
