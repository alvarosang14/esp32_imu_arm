## components/bno055/Kconfig
```kconfig
menu "BNO055"

    # Sensor fusion mode
    choice BNO055_OPMODE
        prompt "Operation mode"
        default BNO055_OPMODE_IMUPLUS

        config BNO055_OPMODE_IMUPLUS
            bool "IMUPLUS (accel + gyro)"

        config BNO055_OPMODE_NDOF
            bool "NDOF (accel + gyro + mag)"

    endchoice

endmenu
```
